/*
**********************************************************************
  тестовый код для  проверки всех устройств "Умный дом" ЙоТик М2
  смотреть в локальной сети по адресу 192.168.4.4
  Ядро esp32 v2.0.1 GyverPortal v3.5.3
  Created by Dmitry Baev
  //********************************************************************
*/

#include <Wire.h>

/////////////////// модуль светодиодов ///////////////////

#include "TLC59108.h"   // библиотека для модуля MGL_RGB1
#define HW_RESET_PIN 0  // Только програмнный сброс
#define I2C_ADDR TLC59108::I2C_ADDR::BASE
TLC59108 leds(I2C_ADDR + 7);   // Без перемычек добавляется 3 бита адреса
TLC59108 leds2(I2C_ADDR + 0);  // Все перемычки на модуле стоят
TLC59108 leds3(I2C_ADDR + 6);  // Стоит только одна перемычка

#include <PCA9634.h>
PCA9634 ledsModul(0x08);  // (также попробуйте просканировать адрес: https://github.com/MAKblC/Codes/tree/master/I2C%20scanner)
PCA9634 ledsModul2(0x10);
PCA9634 ledsModul3(0x70);


#include <BH1750.h>    // добавляем библиотеку датчика освещенности // adding Light intensity sensor library
BH1750 LightSensor_1;  // BH1750

#include <Adafruit_Sensor.h>  // добавляем библиотеку датчика температуры, влажности и давления // adding Temp Hum Bar sensor library
#include <Adafruit_BME280.h>  // BME280
Adafruit_BME280 bme280;       //

#include <ESP32_Servo.h>  // конфигурация сервомотора // servo configuration
Servo servoDor;
Servo servoWindow;

#include <I2C_graphical_LCD_display.h>  // дисплей
I2C_graphical_LCD_display lcd;

// подключить библиотеку файловой системы (до #include GyverPortal)
#include <LittleFS.h>

#include <GyverPortal.h>
GyverPortal ui(&LittleFS);  // передать ссылку на fs (SPIFFS/LittleFS)

// Задаем статический IP-адрес:
IPAddress local_IP(192, 168, 4, 4);
// Задаем IP-адрес сетевого шлюза:
IPAddress gateway(192, 168, 1, 1);

IPAddress subnet(255, 255, 0, 0);

#include <EEPROM.h>
#define EEPROM_SIZE 100

char* AP_SSID;
int number = 0;
bool flagLED;

#define wind 17   // пин вентилятора (16)
#define button 4  // пин кнопки

//переменные для GP
bool flagDor, flagWindow, flagWind, led, flagLCD, flagLight;
int amper = 0;
int light, hum, temp;

const byte picture[] PROGMEM = {  // картинка
  0x00, 0x00, 0x00, 0x00, 0x00, 0x00, 0x00, 0x00, 0x00, 0x00, 0x00, 0x00, 0x00, 0x00, 0x00, 0x00,
  0x00, 0x00, 0x00, 0x00, 0x00, 0x00, 0x00, 0x00, 0x00, 0x00, 0x00, 0x00, 0x00, 0x00, 0x00, 0x00,
  0x00, 0x00, 0x00, 0x00, 0x00, 0x00, 0x00, 0x00, 0x00, 0x00, 0x00, 0x00, 0x00, 0x00, 0x00, 0x00,
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  0x00, 0x00, 0x00, 0x00, 0x00, 0x00, 0x00, 0x00, 0x00, 0x00, 0x00, 0x00, 0x00, 0x00, 0x00, 0x00
};

// конструктор страницы
void build() {
  GP.BUILD_BEGIN();
  GP.THEME(GP_DARK);

  GP.TITLE("MGBot управление Умным домом");
  GP.HR();

  GP.UPDATE("led,lightSH,tSH,humSH");

  GP_MAKE_BOX(GP_CENTER,
              M_BLOCK_TAB(
                "Дверь",
                GP_MAKE_BOX(GP_CENTER,
                            GP.LABEL("Закрыть");
                            GP.SWITCH("dor", flagDor);
                            GP.LABEL("Открыть");

                );

              );

              M_BLOCK_TAB(
                "Окно",
                GP_MAKE_BOX(GP_CENTER,
                            GP.LABEL("Закрыть");
                            GP.SWITCH("window", flagWindow);
                            GP.LABEL("Открыть");

                );

              );

  );
  M_BLOCK_TAB(
    "Амперметр",
    GP_MAKE_BOX(GP_CENTER,
                GP.SLIDER("amper", amper, 0, 10);
                GP.LABEL("A");

    );

  );
  GP_MAKE_BOX(GP_CENTER,

              M_BLOCK_TAB(
                "Вентилятор",
                GP_MAKE_BOX(GP_CENTER,
                            GP.LABEL("Выкл");
                            GP.SWITCH("wind", flagWind);
                            GP.LABEL("Вкл");

                );

              );

              M_BLOCK_TAB(
                "Кнопка",
                GP_MAKE_BOX(GP_CENTER,
                            GP.LABEL("Нажата");
                            GP.LED("led", led);  // + состояние [bool]
                            GP.LABEL("Не нажата");

                );

              );

  );

  M_BLOCK_TAB("Дисплей",
              GP_MAKE_BOX(GP_CENTER,
                          GP.LABEL("Лого");
                          GP.SWITCH("lcd", flagLCD);
                          GP.LABEL("Текст");

              );

  );


  GP_MAKE_BOX(GP_CENTER,
              M_BLOCK_TAB("Освещённость",
                          GP_MAKE_BOX(GP_CENTER,
                                      GP.LABEL_BLOCK("0", "lightSH");
                                      GP.LABEL("lx");

                          );

              );

              M_BLOCK_TAB("Температура",
                          GP_MAKE_BOX(GP_CENTER,
                                      GP.LABEL_BLOCK("0", "tSH");
                                      GP.LABEL("°C");

                          );

              );
              M_BLOCK_TAB("Влажность",
                          GP_MAKE_BOX(GP_CENTER,
                                      GP.LABEL_BLOCK("0", "humSH");
                                      GP.LABEL("%");

                          );

              );

  );

  M_BLOCK_TAB("Свет в доме",
              GP_MAKE_BOX(GP_CENTER,
                          GP.LABEL("Выкл");
                          GP.SWITCH("lWhite", flagLight);
                          GP.LABEL("Вкл");

              );

  );

  GP.BUILD_END();
}

void action() {
  if (ui.click()) {
    if (ui.clickBool("dor", flagDor)) {
      if (flagDor) {
        servoDor.write(100);
      } else {
        servoDor.write(0);
      }
    }
    if (ui.clickBool("window", flagWindow)) {
      if (flagWindow) {
        servoWindow.write(100);
      } else {
        servoWindow.write(0);
      }
    }
    if (ui.clickInt("amper", amper)) {
      ledcWrite(5, amper * 100);
    }
    if (ui.clickBool("wind", flagWind)) {
      digitalWrite(wind, flagWind);
    }
    if (ui.clickBool("lcd", flagLCD)) {
      if (flagLCD) {
        lcd.clear(0, 0, 128, 64, 0x00);
        lcd.string("Privet, MGBOT!", false);
      } else {
        lcd.clear(0, 0, 128, 64, 0x00);
        lcd.blit(picture, sizeof picture);
      }
    }
    if (ui.clickBool("lWhite", flagLight)) {
      if (flagLight == true) {

        leds.setBrightness(0, 0xff);
        leds2.setBrightness(0, 0xff);
        leds3.setBrightness(0, 0xff);
        Serial.println("house is white");

        ledsModul.write1(0, 0xff);
        ledsModul2.write1(0, 0xff);
        ledsModul3.write1(0, 0xff);
        Serial.println("house is white");
        delay(1500);

      } else {

        leds.setBrightness(0, 0x00);
        leds2.setBrightness(0, 0x00);
        leds3.setBrightness(0, 0x00);
        Serial.println("house is dark");

        ledsModul.write1(0, 0x00);
        ledsModul2.write1(0, 0x00);
        ledsModul3.write1(0, 0x00);
        Serial.println("house is dark");
      }
    }
  }

  if (ui.update()) {
    if (ui.update("led")) {
      static bool Button;
      Button = digitalRead(button);
      ui.answer(Button);
      Serial.println(Button);
    }

    if (ui.update("lightSH")) {
      ui.answer(light);
    }
    if (ui.update("tSH")) {
      ui.answer(temp);
    }
    if (ui.update("humSH")) {
      ui.answer(hum);
    }
  }
}

void setup() {
  servoDor.attach(13);     // пин сервомотора // servo pin
  servoWindow.attach(15);  // пин сервомотора // servo pin

  Wire.begin();

  pinMode(button, INPUT);
  pinMode(wind, OUTPUT);  // настройка пинов насоса и вентилятора на выход // pump and cooler pins configured on output mode
  digitalWrite(wind, LOW);

  lcd.begin();
  lcd.gotoxy(0, 0);
  lcd.clear(0, 0, 128, 64, 0x00);  // очищаем поле дисплея
  lcd.blit(picture, sizeof picture);

  startup();

  if (!LittleFS.begin()) Serial.println("FS Error");

  ui.attachBuild(build);
  ui.attach(action);
  ui.start();

  pinMode(18, OUTPUT);

  LightSensor_1.begin();  // запуск датчика освещенности // turn the light intensity sensor on

  bool bme_status = bme280.begin();
  if (!bme_status) {
    Serial.println("Не найден по адресу 0х77, пробую другой...");
    bme_status = bme280.begin(0x76);
    if (!bme_status)
      Serial.println("Датчик не найден, проверьте соединение");
  }

  leds.init(HW_RESET_PIN);
  leds.setLedOutputMode(TLC59108::LED_MODE::PWM_IND);
  leds2.init(HW_RESET_PIN);
  leds2.setLedOutputMode(TLC59108::LED_MODE::PWM_IND);
  leds3.init(HW_RESET_PIN);
  leds3.setLedOutputMode(TLC59108::LED_MODE::PWM_IND);

  ledsModul.begin();
  ledsModul2.begin();
  ledsModul3.begin();
  for (int channel = 0; channel < ledsModul.channelCount(); channel++) {
    ledsModul.setLedDriverMode(channel, PCA9634_LEDOFF);  // выключить все светодиоды в режиме 0/1
    ledsModul2.setLedDriverMode(channel, PCA9634_LEDOFF);
    ledsModul3.setLedDriverMode(channel, PCA9634_LEDOFF);
  }
  for (int channel = 0; channel < ledsModul.channelCount(); channel++) {
    ledsModul.setLedDriverMode(channel, PCA9634_LEDPWM);  // установка режима ШИМ (0-255)
    ledsModul2.setLedDriverMode(channel, PCA9634_LEDPWM);
    ledsModul3.setLedDriverMode(channel, PCA9634_LEDPWM);
  }


  ledcSetup(5, 50, 10);
  ledcAttachPin(14, 5);
}

void loop() {
  static unsigned long timer;

  ui.tick();

  if (millis() - timer >= 500) {
    flagLED = !flagLED;
    digitalWrite(18, flagLED);

    //Собираем показания датчиков
    light = LightSensor_1.readLightLevel();
    Serial.println(String(light) + " lx");
    temp = bme280.readTemperature();
    Serial.println("Air temperature = " + String(temp) + " *C");
    hum = bme280.readHumidity();
    Serial.println("Air humidity = " + String(hum) + " %");

    timer = millis();
  }
}

void startup() {
  Serial.begin(115200);
  EEPROM.begin(EEPROM_SIZE);
  //EEPROM.put(95, number);  //Раскоментить для смены имени сети каждую перезагрузку
  //EEPROM.commit();
  checkNamber();

  WiFi.mode(WIFI_AP);
  Serial.print("Устанавливаем статический IP ---> ");
  Serial.println(WiFi.softAPConfig(local_IP, gateway, subnet) ? "Ready" : "Failed!");
  WiFi.softAP(AP_SSID, "");
  Serial.print("WiFi : ");
  Serial.println(AP_SSID);
  Serial.println(WiFi.softAPIP());
}

void checkNamber() {
  EEPROM.get(95, number);
  Serial.println(number);
  if (number == -1) {
    number = random(10000);
    EEPROM.put(95, number);
    EEPROM.commit();
  }

  String n = "SmartHouse_№-";
  n = n + String(number);

  AP_SSID = strcpy(new char[n.length() + 1], n.c_str());
}
